&ram_data {
	device_type = "ram data region";
	reg = <0x100c00 0x2D800>;
};
&ram_code {
	device_type = "ram code region";
	compatible = "zephyr,memory-region", "arm,itcm";
	reg = <0x12E400 0x9000>;
	zephyr,memory-region = "ITCM";
};
&heap {
	device_type = "heap region";
	reg = <0x137400 0x5800>;
};