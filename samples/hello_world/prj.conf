## CMakeLists.txt
```
# SPDX-License-Identifier: Apache-2.0

cmake_minimum_required(VERSION 3.20.0)

find_package(Zephyr REQUIRED HINTS $ENV{ZEPHYR_BASE})
project(hello_world)

target_sources(app PRIVATE src/main.c)
zephyr_include_directories(src)
# zephyr_ld_options(-Wl,-u,B_func)
zephyr_link_libraries(${CMAKE_CURRENT_SOURCE_DIR}/src/moduleA.a)
zephyr_link_libraries(${CMAKE_CURRENT_SOURCE_DIR}/src/moduleB.a)
zephyr_link_libraries(${CMAKE_CURRENT_SOURCE_DIR}/src/moduleC.a)
```

## prj.conf
```kconfig
# nothing here
CONFIG_OUTPUT_DISASSEMBLY=y
CONFIG_PM=y
# CONFIG_PM_DEBUG_SNAPSHOT=y
```

## src/main.c
```c
/*
 * Copyright (c) 2012-2014 Wind River Systems, Inc.
 *
 * SPDX-License-Identifier: Apache-2.0
 */

#include <stdio.h>
#include <moduleA.h>
#include <moduleB.h>
#include <moduleC.h>


int main(void)
{
	printf("Hello World! %s\n", CONFIG_BOARD_TARGET);

	//A_func();
	C_func();
	return 0;
}
```

## src/moduleA.h
```c
#ifndef MODULEA_H
#define MODULEA_H

void A_func(void); // moduleA.c 提供，被 moduleB.c 调用

#endif
```

## src/moduleB.h
```c
#ifndef MODULEB_H
#define MODULEB_H

void B_func(void); // moduleB.c 提供，被 moduleA.c 调用

#endif
```

## src/moduleC.h
```c
#ifndef MODULEC_H
#define MODULEC_H

void C_func(void);

#endif
```
