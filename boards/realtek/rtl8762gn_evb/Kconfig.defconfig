## boards/realtek/rtl8762gn_evb/Kconfig.defconfig
```kconfig
if BOARD_RTL8762GN_EVB

config BOARD
	default "rtl8762gn_evb"

config SERIAL
	default y

config UART_INTERRUPT_DRIVEN
	default y

config CONSOLE
	default y

config UART_CONSOLE
	default CONSOLE

endif #BOARD_RTL8762GN_EVB
```

## boards/realtek/rtl8762gn_evb/rtl8762gn_evb_defconfig
```kconfig
# Console Driver
CONFIG_CONSOLE=y
CONFIG_UART_CONSOLE=y

# UART Driver
CONFIG_SERIAL=y
# CONFIG_UART_INTERRUPT_DRIVEN=y
# CONFIG_UART_ASYNC_API=y

# General Kernel Options
CONFIG_TICKLESS_KERNEL=n
CONFIG_TIMESLICE_SIZE=10
CONFIG_INIT_STACKS=y
# CONFIG_FPU=y
CONFIG_XIP=y
#place vector table and ISR code to RAM to avoid hardfault triggered by flash-suspend
CONFIG_LINKER_USE_BOOT_SECTION=y

# trustzone related
CONFIG_TRUSTED_EXECUTION_NONSECURE=n
CONFIG_ARM_SECURE_BUSFAULT_HARDFAULT_NMI=y

# DISASSEMBLY
CONFIG_OUTPUT_DISASSEMBLY=y

# flashing
# link application into the the flash partition selected by the zephyr,code-partition property in /chosen in devicetree
```

## soc/realtek/bee/rtl87x2g/Kconfig.defconfig.rtl8762gn
```kconfig
if SOC_RTL8762GN

config SOC
	default "rtl8762gn"

config TRUSTED_EXECUTION_SECURE
	default y

endif # SOC_RTL8762GN
```

## soc/realtek/bee/rtl87x2g/Kconfig.defconfig.series
```kconfig
if SOC_SERIES_RTL87X2G

config CODE_DATA_RELOCATION
	default y

config USE_DT_CODE_PARTITION
	default y

config FPU
	default y if CPU_HAS_FPU

config SOC_SERIES
	default "rtl87x2g"

config SOC_PART_NUMBER
	default "rtl8762gn" if SOC_PART_NUMBER_RTL8762GN

config NUM_IRQS
	int
	default 109

config SYS_CLOCK_HW_CYCLES_PER_SEC
	int
	default 32000

config SYS_CLOCK_TICKS_PER_SEC
	int
	default 100
    #10ms/1tick

config ARCH_HAS_CUSTOM_BUSY_WAIT
	default y

config IDLE_STACK_SIZE
    default 1024

config NUM_METAIRQ_PRIORITIES
	default 1

rsource "Kconfig.defconfig.rtl87*"

endif # SOC_SERIES_RTL87X2G
```
