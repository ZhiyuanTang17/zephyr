## boards/realtek/rtl8752h_evb/board.yml
```yaml
board:
  name: rtl8752h_evb
  vendor: realtek
  socs:
  - name: rtl8752htv
  - name: rtl8752hkf
```

## soc/realtek/bee/Kconfig
```kconfig
# Copyright (c) 2026, Realtek Semiconductor Corporation
# SPDX-License-Identifier: Apache-2.0

config SOC_FAMILY_REALTEK_BEE
	select BUILD_OUTPUT_HEX
	select HAS_SEGGER_RTT if ZEPHYR_SEGGER_MODULE
	select HAS_REALTEK_BEE

if SOC_FAMILY_REALTEK_BEE

rsource "*/Kconfig"

config SOC_FAMILY_REALTEK_BEE_IMAGE_HEADER
	bool
	default y
	help
	  This config will prepend bee_image_header on the zephyr binary.


config CRYPTO_BEE_PSA_ACCELERATOR
	bool "Accelerate PSA AES operations using Realtek Bee hardware"
	depends on MBEDTLS && TF_PSA_CRYPTO_BUILTIN
	default y
	select PSA_WANT_KEY_TYPE_AES
	select PSA_WANT_ALG_ECB_NO_PADDING
	help
	  Route PSA AES-ECB operations to the Realtek Bee hardware engine. This
	  also accelerates composite PSA algorithms such as CCM, whose CBC-MAC
	  and counter mode are built from AES-ECB block encryption.

endif # SOC_FAMILY_REALTEK_BEE
```

## soc/realtek/bee/rtl8752h/Kconfig.defconfig
```kconfig
# Copyright (c) 2024 Realtek Semiconductor Corp.
# SPDX-License-Identifier: Apache-2.0
if SOC_SERIES_RTL8752H

# specifies the frequency of the hardware timer used for the system clock (in Hz)
config SYS_CLOCK_HW_CYCLES_PER_SEC
	int
	default 32000

config NUM_IRQS
	int
	default 32

config CORTEX_M_SYSTICK
	default y

config SYS_CLOCK_TICKS_PER_SEC
	int
	default 100

config TICKLESS_KERNEL
	default n

config TIMESLICE_SIZE
	default 10

config SYSTICK_USE_EXTERNAL_CLOCK
	bool
	default y

config MULTI_HEAP
	default y

config STACK_SENTINEL
	default y

rsource "Kconfig.defconfig.rtl87*"

endif # SOC_SERIES_RTL8752H
```

## tests/boards/realtek/pm/testcase.yaml
```yaml
# Copyright (c) 2024 Realtek Semiconductor Corp.
# SPDX-License-Identifier: Apache-2.0

common:
  tags: pm
  platform_allow:
    - rtl8762j_evb
```
